/**
 * @cliArgs --device "AWR2544" --part "Default" --package "LOP" --context "r5fss0-0" --product "MCU_PLUS_SDK_AWR2544@09.01.00"
 * @versions {"tool":"1.24.0+4110"}
 */

/**
 * Import the modules used in this configuration.
 */
const adcbuf     = scripting.addModule("/drivers/adcbuf/adcbuf", {}, false);
const adcbuf1    = adcbuf.addInstance();
const cbuff      = scripting.addModule("/drivers/cbuff/cbuff", {}, false);
const cbuff1     = cbuff.addInstance();
const crc        = scripting.addModule("/drivers/crc/crc", {}, false);
const crc1       = crc.addInstance();
const edma       = scripting.addModule("/drivers/edma/edma", {}, false);
const edma1      = edma.addInstance();
const gpio       = scripting.addModule("/drivers/gpio/gpio", {}, false);
const gpio1      = gpio.addInstance();
const gpio2      = gpio.addInstance();
const hwa        = scripting.addModule("/drivers/hwa/hwa", {}, false);
const hwa1       = hwa.addInstance();
const ipc        = scripting.addModule("/drivers/ipc/ipc");
const qspi       = scripting.addModule("/drivers/qspi/qspi", {}, false);
const qspi1      = qspi.addInstance();
const clock      = scripting.addModule("/kernel/dpl/clock");
const debug_log  = scripting.addModule("/kernel/dpl/debug_log");
const mpu_armv7  = scripting.addModule("/kernel/dpl/mpu_armv7", {}, false);
const mpu_armv71 = mpu_armv7.addInstance();
const mpu_armv72 = mpu_armv7.addInstance();
const mpu_armv73 = mpu_armv7.addInstance();
const mpu_armv74 = mpu_armv7.addInstance();
const mpu_armv75 = mpu_armv7.addInstance();
const mpu_armv76 = mpu_armv7.addInstance();

/**
 * Write custom configuration values to the imported modules.
 */
adcbuf1.$name = "CONFIG_ADCBUF0";

cbuff1.$name = "CONFIG_CBUFF0";

crc1.$name = "CONFIG_CRC0";

gpio1.$name                = "GPIO_PUSH_BUTTON";
gpio1.trigType             = "RISE_EDGE";
gpio1.GPIO.$assign         = "GPIO8";
gpio1.GPIO.gpioPin.$assign = "PAD_BH";

gpio2.$name        = "GPIO_LED";
gpio2.pinDir       = "OUTPUT";
gpio2.trigType     = "RISE_EDGE";
gpio2.GPIO.$assign = "GPIO2";

hwa1.$name                            = "CONFIG_HWA0";
hwa1.configParamset[0].$name          = "HWA_PARAMSET_CONFIG0";
hwa1.configParamset[0].accelMode      = "HWA_ACCELMODE_FFT";
hwa1.configParamset[0].fftEn          = true;
hwa1.configParamset[0].srcRealComplex = "HWA_SAMPLES_FORMAT_REAL";
hwa1.configParamset[0].windowSymm     = true;
hwa1.configParamset[0].windowMode     = "HWA_WINDOW_MODE_16BITREAL";
hwa1.configParamset[0].triggerMode    = "HWA_TRIG_MODE_SOFTWARE";
hwa1.configParamset[0].mode2x         = true;
hwa1.configCommon[0].$name            = "HWA_COMMON_CONFIG0";

qspi1.$name    = "CONFIG_QSPI0";
qspi1.protocol = "1s_1s_4s";

debug_log.enableUartLog           = true;
debug_log.uartLog.$name           = "CONFIG_UART0";
debug_log.uartLog.UART.$assign    = "UARTA";
debug_log.uartLog.UART.RX.$assign = "PAD_DA";
debug_log.uartLog.UART.TX.$assign = "PAD_DB";

edma1.$name                        = "CONFIG_EDMA0";
qspi1.edmaConfig                   = edma1;
debug_log.uartLog.edmaConfig       = edma1;
cbuff1.edmaConfig                  = edma1;
edma1.regionId                     = 0;
edma1.edmaRmDmaCh[0].$name         = "CONFIG_EDMA_RM0";
edma1.edmaRmQdmaCh[0].$name        = "CONFIG_EDMA_RM1";
edma1.edmaRmTcc[0].$name           = "CONFIG_EDMA_RM2";
edma1.edmaRmParam[0].$name         = "CONFIG_EDMA_RM3";
edma1.edmaRmReservedDmaCh[0].$name = "CONFIG_EDMA_RM4";

mpu_armv71.$name        = "CONFIG_MPU_REGION0";
mpu_armv71.attributes   = "Device";
mpu_armv71.allowExecute = false;

mpu_armv72.$name = "CONFIG_MPU_REGION1";
mpu_armv72.size  = 14;

mpu_armv73.$name    = "CONFIG_MPU_REGION2";
mpu_armv73.baseAddr = 0x80000;
mpu_armv73.size     = 14;

mpu_armv74.$name    = "CONFIG_MPU_REGION3";
mpu_armv74.baseAddr = 0x10200000;
mpu_armv74.size     = 20;

mpu_armv75.$name        = "CONFIG_MPU_REGION4";
mpu_armv75.baseAddr     = 0x102E0000;
mpu_armv75.size         = 16;
mpu_armv75.attributes   = "NonCached";
mpu_armv75.allowExecute = false;

mpu_armv76.$name        = "CONFIG_MPU_REGION5";
mpu_armv76.baseAddr     = 0xC5000000;
mpu_armv76.size         = 13;
mpu_armv76.attributes   = "NonCached";
mpu_armv76.allowExecute = false;

/**
 * Pinmux solution for unlocked pins/peripherals. This ensures that minor changes to the automatic solver in a future
 * version of the tool will not impact the pinmux you originally saw.  These lines can be completely deleted in order to
 * re-solve from scratch.
 */
gpio2.GPIO.gpioPin.$suggestSolution = "PAD_AZ";
qspi1.QSPI["0"].$suggestSolution    = "PAD_AL";
qspi1.QSPI["1"].$suggestSolution    = "PAD_AM";
qspi1.QSPI["2"].$suggestSolution    = "PAD_AN";
qspi1.QSPI["3"].$suggestSolution    = "PAD_AO";
qspi1.QSPI.$suggestSolution         = "QSPI0";
qspi1.QSPI.CLK.$suggestSolution     = "PAD_AP";
qspi1.QSPI.CS.$suggestSolution      = "PAD_AQ";
